## base_external/package/bme280_sensor/Config.in
```kconfig
config BR2_PACKAGE_BME280_SENSOR
	bool "bme280_sensor"
	help
	  Supports building and installing the bme280 sensor driver components into the root filesystem
```

## base_external/package/user-app/Config.in
```kconfig
config BR2_PACKAGE_USER_APP
	bool "user_app"
	help
	  Supports tests against bme280_sensor
```
